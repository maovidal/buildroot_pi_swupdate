## configs/cm4_autoboot_defconfig
```kconfig
# ##############################################################################
# Based on the default `raspberrypicm4io_64_defconfig` of buildroot
# `2022.08.1`. Tested in `2022.08.1`.
# ##############################################################################


BR2_aarch64=y
BR2_cortex_a72=y
BR2_ARM_FPU_VFPV4=y

BR2_TOOLCHAIN_BUILDROOT_CXX=y

BR2_SYSTEM_DHCP="eth0"

# Linux headers same as kernel, a 5.15 series
BR2_PACKAGE_HOST_LINUX_HEADERS_CUSTOM_5_15=y

BR2_LINUX_KERNEL=y
BR2_LINUX_KERNEL_CUSTOM_TARBALL=y
# Kernel 5.15.74
BR2_LINUX_KERNEL_CUSTOM_TARBALL_LOCATION="$(call github,raspberrypi,linux,97a66351f365f1cfc15911fec0bda5e79929cabd)/linux-97a66351f365f1cfc15911fec0bda5e79929cabd.tar.gz"
BR2_LINUX_KERNEL_DEFCONFIG="bcm2711"
# Kernel 5.15 required additional configuration
BR2_LINUX_KERNEL_CONFIG_FRAGMENT_FILES="$(BR2_EXTERNAL_PISWU_CFG_PATH)/board/raspberrypi/generic/linux.fragment"

# Build the DTB from the kernel sources
BR2_LINUX_KERNEL_DTS_SUPPORT=y
BR2_LINUX_KERNEL_INTREE_DTS_NAME="broadcom/bcm2711-rpi-cm4"

BR2_LINUX_KERNEL_NEEDS_HOST_OPENSSL=y

# BR2_PACKAGE_RPI_FIRMWARE=y
BR2_PACKAGE_RPI_FIRMWARE_CUSTOM=y
# BR2_PACKAGE_RPI_FIRMWARE_VARIANT_PI4=y
BR2_PACKAGE_RPI_FIRMWARE_CUSTOM_VARIANT_PI4=y
# BR2_PACKAGE_RPI_FIRMWARE_CONFIG_FILE="$(BR2_EXTERNAL_PISWU_CFG_PATH)/board/raspberrypi/cm4/config_base.txt"
BR2_PACKAGE_RPI_FIRMWARE_CUSTOM_CONFIG_FILE="$(BR2_EXTERNAL_PISWU_CFG_PATH)/board/raspberrypi/cm4/config_base.txt"

# Required tools to create the SD image
BR2_PACKAGE_HOST_DOSFSTOOLS=y
BR2_PACKAGE_HOST_GENIMAGE=y
BR2_PACKAGE_HOST_MTOOLS=y

# Required tool to flash CM4 eMMC memory
BR2_PACKAGE_HOST_RASPBERRYPI_USBBOOT=y

# Filesystem / image
BR2_TARGET_ROOTFS_EXT2=y
BR2_TARGET_ROOTFS_EXT2_4=y
BR2_TARGET_ROOTFS_EXT2_SIZE="128M"
# BR2_TARGET_ROOTFS_TAR is not set
BR2_ROOTFS_POST_BUILD_SCRIPT="$(BR2_EXTERNAL_PISWU_CFG_PATH)/board/raspberrypi/cm4/post-build_autoboot.sh"
BR2_ROOTFS_POST_IMAGE_SCRIPT="$(BR2_EXTERNAL_PISWU_CFG_PATH)/board/raspberrypi/cm4/post-image_autoboot.sh"


# ##############################################################################
# Build requirements
# ##############################################################################

BR2_CCACHE=y
BR2_TOOLCHAIN_BUILDROOT_GLIBC=y
BR2_TARGET_TZ_INFO=y

# Required to be able to load modules automatically
BR2_ROOTFS_DEVICE_CREATION_DYNAMIC_MDEV=y

# Overlays
BR2_ROOTFS_OVERLAY="$(BR2_EXTERNAL_PISWU_CFG_PATH)/board/raspberrypi/generic/overlay"

# Provides a reboot variant that allows parameters (ie. boot partition, tryboot)
BR2_PACKAGE_REBOOTP=y


# ##############################################################################
# Identification and development utilities
# ##############################################################################

# Root password
BR2_TARGET_GENERIC_ROOT_PASSWD="hi"

# System hostname
BR2_TARGET_GENERIC_HOSTNAME="MyDevice"

# System banner
BR2_TARGET_GENERIC_ISSUE="CM4 to test autoboot mechanism ver 0.3.1"

# Utilities
BR2_PACKAGE_NANO=y                  # Edit files
BR2_PACKAGE_DROPBEAR=y              # SSH
BR2_PACKAGE_RSYNC=y                 # Useful to receive files via SSH
BR2_PACKAGE_DHCPCD=y
BR2_PACKAGE_PARTED=y                # Parted, the GNU partition resizing program
BR2_PACKAGE_UTIL_LINUX=y
BR2_PACKAGE_UTIL_LINUX_BINARIES=y   # Install the basic set of util-linux binaries, including lsblk
```

## configs/cm4_defconfig
```kconfig
# ##############################################################################
# Based on the default `raspberrypicm4io_64_defconfig` of the buildroot
# `2022.08.1`. Tested in `2022.08.1`.
# ##############################################################################


BR2_aarch64=y
BR2_cortex_a72=y
BR2_ARM_FPU_VFPV4=y

BR2_TOOLCHAIN_BUILDROOT_CXX=y

BR2_SYSTEM_DHCP="eth0"

# Linux headers same as kernel, a 5.15 series
BR2_PACKAGE_HOST_LINUX_HEADERS_CUSTOM_5_15=y

BR2_LINUX_KERNEL=y
BR2_LINUX_KERNEL_CUSTOM_TARBALL=y
BR2_LINUX_KERNEL_CUSTOM_TARBALL_LOCATION="$(call github,raspberrypi,linux,6f921e98008589258f97243fb6658d09750f0a2f)/linux-6f921e98008589258f97243fb6658d09750f0a2f.tar.gz"
BR2_LINUX_KERNEL_DEFCONFIG="bcm2711"

# Build the DTB from the kernel sources
BR2_LINUX_KERNEL_DTS_SUPPORT=y
BR2_LINUX_KERNEL_INTREE_DTS_NAME="broadcom/bcm2711-rpi-cm4"

BR2_LINUX_KERNEL_NEEDS_HOST_OPENSSL=y

BR2_PACKAGE_RPI_FIRMWARE=y
BR2_PACKAGE_RPI_FIRMWARE_VARIANT_PI4=y
BR2_PACKAGE_RPI_FIRMWARE_CONFIG_FILE="$(BR2_EXTERNAL_PISWU_CFG_PATH)/board/raspberrypi/cm4/config_base.txt"

# Required tools to create the SD image
BR2_PACKAGE_HOST_DOSFSTOOLS=y
BR2_PACKAGE_HOST_GENIMAGE=y
BR2_PACKAGE_HOST_MTOOLS=y

# Required tool to flash CM4 eMMC memory
BR2_PACKAGE_HOST_RASPBERRYPI_USBBOOT=y

# Filesystem / image
BR2_TARGET_ROOTFS_EXT2=y
BR2_TARGET_ROOTFS_EXT2_4=y
BR2_TARGET_ROOTFS_EXT2_SIZE="128M"
# BR2_TARGET_ROOTFS_TAR is not set
BR2_ROOTFS_POST_BUILD_SCRIPT="$(BR2_EXTERNAL_PISWU_CFG_PATH)/board/raspberrypi/cm4/post-build_swupdate.sh"
BR2_ROOTFS_POST_IMAGE_SCRIPT="$(BR2_EXTERNAL_PISWU_CFG_PATH)/board/raspberrypi/cm4/post-image_swupdate.sh"


# ##############################################################################
# Build requirements
# ##############################################################################

BR2_CCACHE=y
BR2_TOOLCHAIN_BUILDROOT_GLIBC=y
BR2_TARGET_TZ_INFO=y

# Required to be able to load modules automatically
BR2_ROOTFS_DEVICE_CREATION_DYNAMIC_MDEV=y

# Overlays
BR2_ROOTFS_OVERLAY="$(BR2_EXTERNAL_PISWU_CFG_PATH)/board/raspberrypi/generic/overlay $(BR2_EXTERNAL_PISWU_CFG_PATH)/board/raspberrypi/generic/overlay_swupdate"

# Provides a reboot variant that allows parameters (ie. boot partition, tryboot)
BR2_PACKAGE_REBOOTP=y


# ##############################################################################
# Identification and development utilities
# ##############################################################################

# Root password
BR2_TARGET_GENERIC_ROOT_PASSWD="hi"

# System hostname
BR2_TARGET_GENERIC_HOSTNAME="MyDevice"

# System banner
BR2_TARGET_GENERIC_ISSUE="CM4 to test SWUpdate ver 0.2.2"

# Utilities
BR2_PACKAGE_NANO=y                  # Edit files
BR2_PACKAGE_DROPBEAR=y              # SSH
BR2_PACKAGE_RSYNC=y                 # Useful to receive files via SSH
BR2_PACKAGE_DHCPCD=y
BR2_PACKAGE_PARTED=y                # Parted, the GNU partition resizing program
BR2_PACKAGE_UTIL_LINUX=y
BR2_PACKAGE_UTIL_LINUX_BINARIES=y   # Install the basic set of util-linux binaries, including lsblk


# ##############################################################################
# SWUpdate
# ##############################################################################

# SWUpdate
BR2_PACKAGE_SWUPDATE=y
BR2_PACKAGE_SWUPDATE_INSTALL_WEBSITE=y
BR2_PACKAGE_SWUPDATE_CONFIG="$(BR2_EXTERNAL_PISWU_CFG_PATH)/board/raspberrypi/generic/swupdate.config"

# Do compress the ext2/3/4 filesystem with gzip
BR2_TARGET_ROOTFS_EXT2_GZIP=y

# To be able to read configuration on the format provided
BR2_PACKAGE_LIBCONFIG=y

# Web service requirements
BR2_PACKAGE_LIBCURL=y
BR2_PACKAGE_JSON_C=y

# To allow disk management
BR2_PACKAGE_E2FSPROGS=y

# fsck with fsck.vfat and fsck.ext2 support.
BR2_PACKAGE_DOSFSTOOLS=y
BR2_PACKAGE_DOSFSTOOLS_FSCK_FAT=y
BR2_PACKAGE_DOSFSTOOLS_MKFS_FAT=y
```

## configs/cm4_tryboot_defconfig
```kconfig
# ##############################################################################
# Based on the default `raspberrypicm4io_64_defconfig` of the buildroot
# `2022.08.1`. Tested in `2022.08.1`.
# ##############################################################################


BR2_aarch64=y
BR2_cortex_a72=y
BR2_ARM_FPU_VFPV4=y

BR2_TOOLCHAIN_BUILDROOT_CXX=y

BR2_SYSTEM_DHCP="eth0"

# Linux headers same as kernel, a 5.15 series
BR2_PACKAGE_HOST_LINUX_HEADERS_CUSTOM_5_15=y

BR2_LINUX_KERNEL=y
BR2_LINUX_KERNEL_CUSTOM_TARBALL=y
BR2_LINUX_KERNEL_CUSTOM_TARBALL_LOCATION="$(call github,raspberrypi,linux,6f921e98008589258f97243fb6658d09750f0a2f)/linux-6f921e98008589258f97243fb6658d09750f0a2f.tar.gz"
BR2_LINUX_KERNEL_DEFCONFIG="bcm2711"

# Build the DTB from the kernel sources
BR2_LINUX_KERNEL_DTS_SUPPORT=y
BR2_LINUX_KERNEL_INTREE_DTS_NAME="broadcom/bcm2711-rpi-cm4"

BR2_LINUX_KERNEL_NEEDS_HOST_OPENSSL=y

BR2_PACKAGE_RPI_FIRMWARE=y
BR2_PACKAGE_RPI_FIRMWARE_VARIANT_PI4=y
BR2_PACKAGE_RPI_FIRMWARE_CONFIG_FILE="$(BR2_EXTERNAL_PISWU_CFG_PATH)/board/raspberrypi/cm4/config_a.txt"

# Required tools to create the SD image
BR2_PACKAGE_HOST_DOSFSTOOLS=y
BR2_PACKAGE_HOST_GENIMAGE=y
BR2_PACKAGE_HOST_MTOOLS=y

# Required tool to flash CM4 eMMC memory
BR2_PACKAGE_HOST_RASPBERRYPI_USBBOOT=y

# Filesystem / image
BR2_TARGET_ROOTFS_EXT2=y
BR2_TARGET_ROOTFS_EXT2_4=y
BR2_TARGET_ROOTFS_EXT2_SIZE="512M"
# BR2_TARGET_ROOTFS_TAR is not set
BR2_ROOTFS_POST_BUILD_SCRIPT="$(BR2_EXTERNAL_PISWU_CFG_PATH)/board/raspberrypi/cm4/post-build_tryboot.sh"
BR2_ROOTFS_POST_IMAGE_SCRIPT="$(BR2_EXTERNAL_PISWU_CFG_PATH)/board/raspberrypi/cm4/post-image_tryboot.sh"


# ##############################################################################
# Build requirements
# ##############################################################################

BR2_CCACHE=y
BR2_TOOLCHAIN_BUILDROOT_GLIBC=y
BR2_TARGET_TZ_INFO=y

# Required to be able to load modules automatically
BR2_ROOTFS_DEVICE_CREATION_DYNAMIC_MDEV=y

# Overlays
BR2_ROOTFS_OVERLAY="$(BR2_EXTERNAL_PISWU_CFG_PATH)/board/raspberrypi/common/overlay"


# ##############################################################################
# Identification and development utilities
# ##############################################################################

# Root password
BR2_TARGET_GENERIC_ROOT_PASSWD="hi"

# System hostname
BR2_TARGET_GENERIC_HOSTNAME="MyDevice"

# System banner
BR2_TARGET_GENERIC_ISSUE="CM4 based on tryboot ver 0.1.0 - Working!"

# Utilities
BR2_PACKAGE_NANO=y  # Edit files
BR2_PACKAGE_DROPBEAR=y  # SSH
BR2_PACKAGE_RSYNC=y  # Useful to receive files via SSH
BR2_PACKAGE_DHCPCD=y
BR2_PACKAGE_PARTED=y  # Parted, the GNU partition resizing program
BR2_PACKAGE_UTIL_LINUX=y
BR2_PACKAGE_UTIL_LINUX_BINARIES=y  # Install the basic set of util-linux binaries, including lsblk

# BR2_PACKAGE_SUDO=y

BR2_PACKAGE_REBOOTP=y


# ##############################################################################
# SWUpdate
# ##############################################################################

# Do compress the ext2/3/4 filesystem with gzip
# BR2_TARGET_ROOTFS_EXT2_GZIP=y # Seems to remove ext4?

# Link Time Optimization (LTO) gives GCC the capability of dumping its internal representation (GIMPLE) to disk, so that all the different compilation units that make up a single executable can be optimized as a single module.
# BR2_GCC_ENABLE_LTO=y
```

## configs/pi2_autoboot_defconfig
```kconfig
# ##############################################################################
# Based on the default `raspberrypi2_defconfig` of the buildroot
# `2022.08.1`. Tested in `2022.08.1`
# ##############################################################################


BR2_arm=y
BR2_cortex_a7=y
BR2_ARM_EABIHF=y
BR2_ARM_FPU_NEON_VFPV4=y

BR2_TOOLCHAIN_BUILDROOT_CXX=y

BR2_SYSTEM_DHCP="eth0"

# Linux headers same as kernel, a 5.15 series
BR2_PACKAGE_HOST_LINUX_HEADERS_CUSTOM_5_15=y

BR2_LINUX_KERNEL=y
BR2_LINUX_KERNEL_CUSTOM_TARBALL=y
BR2_LINUX_KERNEL_CUSTOM_TARBALL_LOCATION="$(call github,raspberrypi,linux,6f921e98008589258f97243fb6658d09750f0a2f)/linux-6f921e98008589258f97243fb6658d09750f0a2f.tar.gz"
BR2_LINUX_KERNEL_DEFCONFIG="bcm2709"

# Build the DTB from the kernel sources
BR2_LINUX_KERNEL_DTS_SUPPORT=y
BR2_LINUX_KERNEL_INTREE_DTS_NAME="bcm2709-rpi-2-b"

BR2_LINUX_KERNEL_NEEDS_HOST_OPENSSL=y

BR2_PACKAGE_RPI_FIRMWARE=y
BR2_PACKAGE_RPI_FIRMWARE_BOOTCODE_BIN=y
BR2_PACKAGE_RPI_FIRMWARE_VARIANT_PI=y
BR2_PACKAGE_RPI_FIRMWARE_CONFIG_FILE="$(BR2_EXTERNAL_PISWU_CFG_PATH)/board/raspberrypi/pi2/config.txt"
# BR2_PACKAGE_RPI_FIRMWARE_INSTALL_DTB_OVERLAYS is not set

# Required tools to create the SD image
BR2_PACKAGE_HOST_DOSFSTOOLS=y
BR2_PACKAGE_HOST_GENIMAGE=y
BR2_PACKAGE_HOST_MTOOLS=y

# Filesystem / image
BR2_TARGET_ROOTFS_EXT2=y
BR2_TARGET_ROOTFS_EXT2_4=y
BR2_TARGET_ROOTFS_EXT2_SIZE="512M"
# BR2_TARGET_ROOTFS_TAR is not set
BR2_ROOTFS_POST_BUILD_SCRIPT="$(BR2_EXTERNAL_PISWU_CFG_PATH)/board/raspberrypi/pi2/post-build_autoboot.sh"
BR2_ROOTFS_POST_IMAGE_SCRIPT="$(BR2_EXTERNAL_PISWU_CFG_PATH)/board/raspberrypi/pi2/post-image_autoboot.sh"

# ##############################################################################
# Build requirements
# ##############################################################################

BR2_CCACHE=y
BR2_TOOLCHAIN_BUILDROOT_GLIBC=y
BR2_TARGET_TZ_INFO=y

# Required to be able to load modules automatically
BR2_ROOTFS_DEVICE_CREATION_DYNAMIC_MDEV=y

# Overlays
BR2_ROOTFS_OVERLAY="$(BR2_EXTERNAL_PISWU_CFG_PATH)/board/raspberrypi/common/overlay"


# ##############################################################################
# Identification and development utilities
# ##############################################################################

# Root password
BR2_TARGET_GENERIC_ROOT_PASSWD="hi"

# System hostname
BR2_TARGET_GENERIC_HOSTNAME="MyDevice"

# System banner
BR2_TARGET_GENERIC_ISSUE="Pi2B *Preliminar to test support for autoboot* ver 0.0.5"

# Utilities
BR2_PACKAGE_NANO=y  # Edit files
BR2_PACKAGE_DROPBEAR=y  # SSH
BR2_PACKAGE_RSYNC=y  # Useful to receive files via SSH
BR2_PACKAGE_DHCPCD=y
BR2_PACKAGE_PARTED=y  # Parted, the GNU partition resizing program
BR2_PACKAGE_UTIL_LINUX=y
BR2_PACKAGE_UTIL_LINUX_BINARIES=y  # Install the basic set of util-linux binaries, including lsblk


# ##############################################################################
# SWUpdate
# ##############################################################################

# Do compress the ext2/3/4 filesystem with gzip
# BR2_TARGET_ROOTFS_EXT2_GZIP=y # Seems to remove ext4?

# Link Time Optimization (LTO) gives GCC the capability of dumping its internal representation (GIMPLE) to disk, so that all the different compilation units that make up a single executable can be optimized as a single module.
# BR2_GCC_ENABLE_LTO=y
```

## package/rebootp/Config.in
```kconfig
config BR2_PACKAGE_REBOOTP
        bool "rebootp"
    ### build dependencies
    ### runtime dependencies
        help
          modified reboot to a given partition based on PINN's rebootp
          Original at:
          https://github.com/procount/pinn/tree/master/buildroot/package/rebootp
```
